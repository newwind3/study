## linux/kernel/kernel-3.4.39/drivers/ak/Kconfig
```kconfig
menu "Astell&Kern support"

config SND_USE_DYNAMIC_CONF
	prompt "Use dynamic configurations"
	bool

menuconfig SND_AK_AUDIO
	bool "Use Astell&Kern audio module"

if SND_AK_AUDIO
source "sound/soc/akaudio/Kconfig"
endif

config AK_MODEL_FEATURES
	bool "Enable distinguishing Astell&Kern models and features"

config AK_GPIO_CONFIGS
	bool "Enable Astell&Kern GPIO configuration"

endmenu
```

## linux/kernel/kernel-3.4.39/drivers/switch/Kconfig
```kconfig
menuconfig SWITCH
	tristate "Switch class support"
	help
	  Say Y here to enable switch class support. This allows
	  monitoring switches by userspace via sysfs and uevent.

if SWITCH

config SWITCH_GPIO
	tristate "GPIO Swith support"
	depends on GENERIC_GPIO
	help
	  Say Y here to enable GPIO based switch support.

config SWITCH_GPIO_AK
        tristate "GPIO Swith support(AK)"
        depends on GENERIC_GPIO
        help
          Say Y here to enable GPIO based switch support for ak.	  
          
endif # SWITCH
```

## linux/kernel/kernel-3.4.39/sound/soc/akaudio/Kconfig
```kconfig
if !SND_USE_DYNAMIC_CONF

choice SND_AK_DAC
	prompt "Select DAC device"
	depends on SND_AK_AUDIO
	default SND_AK_CS4398

config SND_AK_CS4398
	bool "CS4398"

endchoice

config SND_AK_DAC_COUNT
	int "Number of DACs"
	default 1

endif
```
